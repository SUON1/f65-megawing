/* Generated by m2_rebuild/residency.py; development profile only. */
INCLUDE src/platform/m2_rebuild/startup.ld
__m2re_noinit_start = ADDR(.noinit);
__m2re_noinit_end = ADDR(.noinit) + SIZEOF(.noinit);
ASSERT(ADDR(.basic_header) == 0x2001, "extended profile PRG origin changed")
ASSERT(ADDR(.text) + SIZEOF(.text) <= 0x9000, "extended profile text exceeds $9000")
ASSERT(ADDR(.rodata) + SIZEOF(.rodata) <= 0x9000, "extended profile constants exceed $9000")
ASSERT(ADDR(.data) + SIZEOF(.data) <= 0x9000, "extended profile data exceeds $9000")
ASSERT(ADDR(.bss) + SIZEOF(.bss) <= 0x9000, "extended profile BSS exceeds $9000")
ASSERT(__m2re_noinit_end <= 0x9000, "extended profile scratch exceeds $9000")
ASSERT(__stack == 0xd000, "extended profile software stack changed")
ASSERT(m2rb_startup < 0x8000, "normalization entry must precede extension")
ASSERT(m2re_startup_done < 0x8000, "visibility checks must precede extension")
